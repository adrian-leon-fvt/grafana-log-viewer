VERSION ""

NS_ :

BS_:

BU_: VCU DEV0 DEV1 DEV2 DEV3 DEV4 DEV5 DEV6

BO_ 544 RCS_DEV0_T3IO_OUT0_m: 8 VCU
 SG_ RCS_DEV0_X14A_Y115 : 58|1@1+ (1,0) [0|1] ""  DEV0

BO_ 546 RCS_DEV2_T3IO_OUT1_m: 8 VCU
 SG_ RCS_DEV2_X7_Y193_byte_lo : 0|8@1+ (1,0) [0|255] ""  DEV2
 SG_ RCS_DEV2_X7_Y193_byte_hi : 40|2@1+ (1,0) [0|3] ""  DEV2

BO_ 674 RCS_DEV2_T3IO_ANALOG_IN_m: 8 DEV2
 SG_ RCS_DEV2_mux M : 62|2@1+ (1,0) [0|3] ""  VCU
 SG_ RCS_DEV2_X2B_B456_byte_lo m1 : 0|8@1+ (1,0) [0|255] ""  VCU
 SG_ RCS_DEV2_X2B_B456_byte_hi m1 : 48|4@1+ (1,0) [0|15] ""  VCU

BO_ 677 RCS_DEV5_T3IO_ANALOG_IN_m: 8 DEV5
 SG_ RCS_DEV5_mux M : 62|2@1+ (1,0) [0|3] ""  VCU
 SG_ RCS_DEV5_X2B_B188_byte_lo m1 : 0|8@1+ (1,0) [0|255] ""  VCU
 SG_ RCS_DEV5_X2B_B188_byte_hi m1 : 48|4@1+ (1,0) [0|15] ""  VCU

BA_DEF_  "BusType" STRING ;
BA_DEF_ BO_  "CanDootDecode" ENUM  "No","Yes";
BA_DEF_ BO_  "CanDootDecodeBus" INT 0 6;
BA_DEF_ BO_  "CanDootSimulateBus" INT 0 6;
BA_DEF_ BO_  "CanDootSimulateCycleTime" INT 0 50000;
BA_DEF_ SG_  "CanDootBroadcast" ENUM  "No","Yes";
BA_DEF_ SG_  "CG_VarType" ENUM  "bool","uint8_t","int8_t","uint16_t","int16_t","uint32_t","int32_t","float","double";
BA_DEF_DEF_  "BusType" "CAN";
BA_DEF_DEF_  "CanDootDecode" "Yes";
BA_DEF_DEF_  "CanDootDecodeBus" 1;
BA_DEF_DEF_  "CanDootSimulateBus" 1;
BA_DEF_DEF_  "CanDootSimulateCycleTime" 100;
BA_DEF_DEF_  "CanDootBroadcast" "Yes";
BA_DEF_DEF_  "CG_VarType" "uint8_t";
